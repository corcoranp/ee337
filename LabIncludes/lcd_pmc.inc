;******************************************************************************
;*                                                                            *
;*                  .---------------------------------.                       *           
;*                  |  .---------------------------.  |                       *      
;*                  |[]|                           |[]|                       *      
;*                  |  | Name: Peter M. Corcoran   |  |                       *      
;*                  |  | BlazerID: PMCORCOR        |  |                       *      
;*                  |  | Program: LCD Includes     |  |                       *      
;*                  |  | Version: 1.0              |  |                       *      
;*                  |  | Date: September 28, 2014  |  |                       *      
;*                  |  |                           |  |                       *      
;*                  |  |                           |  |                       *      
;*                  |  |                           |  |                       *      
;*                  |  `---------------------------'  |                       *      
;*                  |      __________________ _____   |                       *      
;*                  |     |   ___            |     |  |                       *      
;*                  |     |  |   |           |     |  |                       *      
;*                  |     |  |   |           |     |  |                       *      
;*                  |     |  |   |           |     |  |                       *      
;*                  |     |  |___|           |     |  |                       *      
;*                  \_____|__________________|_____|__|                       *
;*                                                                            *
;******************************************************************************
; Description: LCD General Variables
;******************************************************************************
;* GLOBAL DATA CONDITIONING



AUTHOR:           FCC      "BY:PETE CORCORAN"
EMPTY:            FCC      "                "

MENU_WELCOME:     FCC      " WELCOME 2 LAB! "
MAINMENU:         FCC      "Run a Lab by    "
MAINMENU1:        FCC      "pressing its    "
MAINMENU2:        FCC      "number on keypad"
MAINMENU3:        FCC      "0:Lab-0  1:Lab-1"
MAINMENU4:        FCC      "2:Lab-2  3:Lab-3"
MAINMENU5:        FCC      "#2: Lab 2       "
MENULAB0:         FCC      "Lab 0 Selected! "
MENULAB1:         FCC      "Lab 1 Selected! "
MENULAB2:         FCC      "Lab 2 Selected! "
MENULAB3:         FCC      "Lab 3 Selected! "


PRESS2CONTINUE:   FCC      "press * to cont."