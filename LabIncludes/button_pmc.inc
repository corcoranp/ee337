;******************************************************************************
;*                                                                            *
;*                  .---------------------------------.                       *           
;*                  |  .---------------------------.  |                       *      
;*                  |[]|                           |[]|                       *      
;*                  |  | Name: Peter M. Corcoran   |  |                       *      
;*                  |  | BlazerID: PMCORCOR        |  |                       *      
;*                  |  | Program: Keypad Includes  |  |                       *      
;*                  |  | Version: 1.0              |  |                       *      
;*                  |  | Date: September 28, 2014  |  |                       *      
;*                  |  |                           |  |                       *      
;*                  |  |                           |  |                       *      
;*                  |  |                           |  |                       *      
;*                  |  `---------------------------'  |                       *      
;*                  |      __________________ _____   |                       *      
;*                  |     |   ___            |     |  |                       *      
;*                  |     |  |   |           |     |  |                       *      
;*                  |     |  |   |           |     |  |                       *      
;*                  |     |  |   |           |     |  |                       *      
;*                  |     |  |___|           |     |  |                       *      
;*                  \_____|__________________|_____|__|                       *
;*                                                                            *
;******************************************************************************
; Description: Keypad General Variables
;******************************************************************************
;* GLOBAL DATA CONDITIONING


KeyPressed:    EQU      16

KEYPAD:        EQU      $00000000         ;Port A 
KEYPAD_DIR:    EQU      $00000002         ;Port A DDR
               ;0   1   2   3   4   5   6   7   8   9  10  11  12  13  14  15 
KEYS: DC.B     $11,$12,$14,$18,$21,$22,$24,$28,$41,$42,$44,$48,$81,$82,$84,$88           


PB_DIR:        EQU      $00000262         ;SET PUSH BUTTON  DIRECTION 